## arch/arm/mach-rockchip/rk3568/Kconfig
```kconfig
if ROCKCHIP_RK3568

config TARGET_EVB_RK3568
	bool "EVB_RK3568"
	select BOARD_LATE_INIT
	help
	  RK3568 EVB is a evaluation board for Rockchp RK3568.

config TARGET_QUARTZ64_RK3566
	bool "QUARTZ64_RK3566"
	select BOARD_LATE_INIT
	help
	  The quartz64-rk3566 is a single board computer from pine64.

config SYS_SOC
	default "rockchip"

config SYS_MALLOC_F_LEN
	default 0x400

source board/rockchip/evb_rk3568/Kconfig
source board/pine64/quartz64_rk3566/Kconfig

endif
```

## board/pine64/pinetab2/Kconfig
```kconfig
if TARGET_PINETAB2

config SYS_BOARD
	default "pinetab2"

config SYS_VENDOR
	default "pine64"

config SYS_CONFIG_NAME
	default "rk3566-pinetab2"

config BOARD_SPECIFIC_OPTIONS # dummy
	def_bool y

endif
```
